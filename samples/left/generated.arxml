AUTOSAR XML (schema 00054)
package /Pkg000
  application sw component type SwComp1
    behavior internal1
      runnable run2
